## meta-onekvm-extension-easytier/conf/layer.conf
```bitbake
BBPATH .= ":${LAYERDIR}"
BBFILES += "${LAYERDIR}/recipes-*/*/*.bb ${LAYERDIR}/recipes-*/*/*.bbappend"
BBFILE_COLLECTIONS += "onekvm-extension-easytier"
BBFILE_PATTERN_onekvm-extension-easytier := "^${LAYERDIR}/"
BBFILE_PRIORITY_onekvm-extension-easytier = "8"
LAYERDEPENDS_onekvm-extension-easytier = "core onekvm"
LAYERSERIES_COMPAT_onekvm-extension-easytier = "wrynose"
```
